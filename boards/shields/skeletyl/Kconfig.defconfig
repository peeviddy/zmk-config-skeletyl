## boards/shields/skeletyl/Kconfig.defconfig
```kconfig
if SHIELD_SKELETYL_LEFT

# Max 16 characters in keyboard name
config ZMK_KEYBOARD_NAME
    default "Skeletyl-BT"

config ZMK_SPLIT_ROLE_CENTRAL
    default y

endif

if SHIELD_SKELETYL_LEFT || SHIELD_SKELETYL_RIGHT

config ZMK_SPLIT
    default y

endif
```

## boards/shields/skeletyl/Kconfig.shield
```kconfig
# No whitespace after the comma or in the keyboard name!
config SHIELD_SKELETYL_DONGLE
    def_bool $(shields_list_contains,skeletyl_dongle)
```

## config/boards/shields/skeletyl/Kconfig.shield
```kconfig
# No whitespace after the comma or in the keyboard name!

config SHIELD_SKELETYL_LEFT
    def_bool $(shields_list_contains,skeletyl_left)

config SHIELD_SKELETYL_RIGHT
    def_bool $(shields_list_contains,skeletyl_right)
```
